#include <avr/pgmspace.h>
#include "SSD1306_minimal.h"
#include <util/delay.h>
#include <string.h>



// a 5x7 font table
const unsigned char  BasicFont[] PROGMEM = {
  0x00, 0x00, 0x00, 0x00, 0x00,   
	0x3E, 0x5B, 0x4F, 0x5B, 0x3E, 	
	0x3E, 0x6B, 0x4F, 0x6B, 0x3E, 	
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	0x00, 0x00, 0x00, 0x00, 0x00, 
};


unsigned char getFlash( const unsigned char * mem, unsigned int idx  ){
  unsigned char data= pgm_read_byte( &(mem[idx]) );
  return data;

}


void printChar( char ch ){
    
    char data[5];
    unsigned char i= ch;
    
    data[0]= getFlash(BasicFont, i*5 );
    data[1]= getFlash(BasicFont, i*5 + 1);
    data[2]= getFlash(BasicFont, i*5 + 2);
    data[3]= getFlash(BasicFont, i*5 + 3);
    data[4]= getFlash(BasicFont, i*5 + 4);    
    
    Wire.beginTransmission(SlaveAddress);
    Wire.send(GOFi2cOLED_Data_Mode);            // data mode
    
    Wire.send( 0x00 );
    Wire.send( data[0] );
    Wire.send( data[1] );
    Wire.send( data[2] );
    Wire.send( data[3] );
    Wire.send( data[4] );
    Wire.send( 0x00 );
      
    Wire.endTransmission();
  
}

void printString( char * pText ){
  unsigned char i;
  unsigned char len = strlen( pText );
  
  for (i=0;i<len;i++){
     printChar( pText[i] ); 
  }
  
}


void clipArea(unsigned char col, unsigned char row, unsigned char w, unsigned char h){
  
  TinyWireM.begin();                    //initialize I2C
  TinyWireM.beginTransmission(SlaveAddress); // begin I2C transmission
  TinyWireM.send(GOFi2cOLED_Command_Mode);            // data mode
  TinyWireM.send(Set_Column_Address_Cmd);
  TinyWireM.send(0);

  TinyWireM.send(col);
  TinyWireM.send(col+w-1);

  TinyWireM.endTransmission();                    // stop I2C transmission

  TinyWireM.begin();                    //initialize I2C
  TinyWireM.beginTransmission(SlaveAddress); // begin I2C transmission
  TinyWireM.send(GOFi2cOLED_Command_Mode);            // data mode
  TinyWireM.send(Set_Page_Address_Cmd);
  TinyWireM.send(0);

  TinyWireM.send(row); 
  TinyWireM.send(row+h-1);

  TinyWireM.endTransmission();                    // stop I2C transmission

}

void sendCommand(unsigned char command){
  Wire.begin();                       //initialize I2C
  Wire.beginTransmission(SlaveAddress); // begin I2C communication

  Wire.send(GOFi2cOLED_Command_Mode);	     // Set OLED Command mode
  Wire.send(command);

  Wire.endTransmission();    		     // End I2C communication
}



void cursorTo(unsigned char col, unsigned char row){
  clipArea(col, row, 128-col, 8-row);
}


void startScreen(){
  sendCommand(0x00 | 0x0);  // low col = 0
  sendCommand(0x10 | 0x0);  // hi col = 0
  sendCommand(0x40 | 0x0); // line #0
}

void clear() {
  
  sendCommand(0x00 | 0x0);  // low col = 0
  sendCommand(0x10 | 0x0);  // hi col = 0
  sendCommand(0x40 | 0x0); // line #0
    
  clipArea(0,0,128,8);
  
    for (uint16_t i=0; i<=((128*64/8)/16); i++) {
      // send a bunch of data in one xmission
      Wire.beginTransmission(SlaveAddress);
      Wire.send(GOFi2cOLED_Data_Mode);            // data mode
      for (uint8_t k=0;k<16;k++){
        Wire.send( 0 );
      }
      Wire.endTransmission();
    }
}


void displayInit(uint8_t address) {
  Wire.begin();
  _delay_ms(5);	// wait for OLED hardware init

  sendCommand(GOFi2cOLED_Display_Off_Cmd);    /*display off*/

  sendCommand(Set_Multiplex_Ratio_Cmd);    /*multiplex ratio*/
  sendCommand(0x3F);    /*duty = 1/64*/

  sendCommand(Set_Display_Offset_Cmd);    /*set display offset*/
  sendCommand(0x00);


  sendCommand(Set_Memory_Addressing_Mode_Cmd); 	//set addressing mode
  sendCommand(HORIZONTAL_MODE); 			//set horizontal addressing mode

  sendCommand(0xB0); 			//set page address
  sendCommand(0x00); 	//set column lower address
  sendCommand(0x10); 	//set column higher address



  sendCommand(0x40);    /*set display starconstructort line*/

  sendCommand(Set_Contrast_Cmd);    /*contract control*/
  sendCommand(0xcf);    /*128*/

  sendCommand(Segment_Remap_Cmd);    /*set segment remap*/

  sendCommand(COM_Output_Remap_Scan_Cmd);    /*Com scan direction*/

  sendCommand(GOFi2cOLED_Normal_Display_Cmd);    /*normal / reverse*/

  sendCommand(Set_Display_Clock_Divide_Ratio_Cmd);    /*set osc division*/
  sendCommand(0x80);

  sendCommand(Set_Precharge_Period_Cmd);    /*set pre-charge period*/
  sendCommand(0xf1);

  sendCommand(Set_COM_Pins_Hardware_Config_Cmd);    /*set COM pins*/
  sendCommand(0x12);

  sendCommand(Set_VCOMH_Deselect_Level_Cmd);    /*set vcomh*/
  sendCommand(0x30);

  sendCommand(Deactivate_Scroll_Cmd);

  sendCommand(Charge_Pump_Setting_Cmd);    /*set charge pump enable*/
  sendCommand(Charge_Pump_Enable_Cmd);

  sendCommand(GOFi2cOLED_Display_On_Cmd);    /*display ON*/
}


void drawImage( const unsigned char * img, unsigned char col, unsigned char row, unsigned char w, unsigned char h ){
  unsigned int i,k,data;

  clipArea( col, row, w, h);

  for (i=0;i< (w*h);i++){
    data= getFlash( img, i);
    Wire.beginTransmission(SlaveAddress);
    Wire.send(GOFi2cOLED_Data_Mode);            // data mode
    Wire.send( data );
    Wire.endTransmission();
  }
  
}

void sendData(unsigned char data) {
  Wire.beginTransmission(SlaveAddress);
  Wire.send(GOFi2cOLED_Data_Mode);
  Wire.send(data);
  Wire.endTransmission();
}

void drawImage2( const unsigned char * img, unsigned char col, unsigned char row, unsigned char w, unsigned char h ) {
  
  sendCommand(0x20); // send memory addressing mode
  sendCommand(0); // horizontal addressing mode
  
  sendCommand(0x21); // send column start / end address command
  sendCommand(col); 
  sendCommand(col+w-1);

  sendCommand(0x22); // send column start / end address command
  sendCommand(row/8);
  sendCommand((row+h)/8-1);


  // const unsigned char go [] = {
  // 0xFF01, 0x0101, 0x0101, 0x0101, 0x0101, 0x0181, 0x81C1, 0xE1E1,
  // 0xE1F1, 0xF1F1, 0xF1F1, 0xF1F1, 0xF1F1, 0x7101, 0x0101, 0x0101,
  // 0x0101, 0x0181, 0xC1C1, 0xE1E1, 0xF1F1, 0xF1E1, 0xE1C1, 0xC181,
  // 0x0101, 0x0101, 0x0101, 0x0101, 0xF1F1, 0xF1F1, 0xF1F1, 0xF1F1,
  // 0xF101, 0x0101, 0xF1F1, 0xF1F1, 0xF1F1, 0xF1F1, 0xF101, 0x0101,
  // 0x01F1, 0xF1F1, 0xF1F1, 0xF1F1, 0xF1F1, 0x0101, 0x0101, 0xFFFF,
  // 0x0000, 0x0000, 0x0000, 0xE0F8, 0xFEFF, 0xFFFF, 0xFFFF, 0x7F3F,
  // 0x1F0F, 0x0F0F, 0x0F0F, 0x0F0F, 0x0F00, 0x0000, 0x0000, 0xE0F8,
  // 0xFEFF, 0xFFFF, 0xFF7F, 0x3F1F, 0x1F3F, 0x7FFF, 0xFFFF, 0xFFFF,
  // 0xFCF0, 0x0000, 0x0000, 0xFFFF, 0xFFFF, 0xFFFF, 0xFFFF, 0xFF01,
  // 0x0000, 0xFFFF, 0xFFFF, 0xFFFF, 0xFFFF, 0xFF01, 0x0000, 0x00FF,
  // 0xFFFF, 0xFFFF, 0xFFFF, 0xFFFF, 0x0100, 0x0000, 0x00FF, 0xFF00,
  // 0x0000, 0x0060, 0xFFFF, 0xFFFF, 0xFFFF, 0xFF03, 0x007E, 0x7E7E,
  // 0x3E3E, 0xFEFE, 0xFEFE, 0xFEFE, 0x1E00, 0x0000, 0xFFFF, 0xFFFF,
  // 0xFFFF, 0xFF01, 0x0000, 0x0000, 0x0000, 0x81FF, 0xFFFF, 0xFFFF,
  // 0xFF3F, 0x0000, 0x00FF, 0xFFFF, 0xFFFF, 0xFFFF, 0xFF1F, 0x0000,
  // 0x00FF, 0xFFFF, 0xFFFF, 0xFFFF, 0xFF1F, 0x0000, 0x0000, 0xFFFF,
  // 0xFFFF, 0xFFFF, 0xFFFF, 0x1F00, 0x0000, 0x0000, 0xFFFF, 0x0000,
  // 0x0000, 0x000F, 0x1F3F, 0x7FFF, 0xFFFF, 0xFEFC, 0xFCFC, 0xFCFE,
  // 0xFFFF, 0x7F3F, 0x1F0F, 0x0100, 0x0000, 0x0007, 0x1F7F, 0xFFFF,
  // 0xFFFF, 0xFEFC, 0xF8F8, 0xF8FC, 0xFEFF, 0xFFFF, 0x7F3F, 0x0F03,
  // 0x0000, 0x00E0, 0xF1F1, 0xF1F9, 0xF9F1, 0xF1F1, 0xE000, 0x00E0,
  // 0xF1F1, 0xF1F9, 0xF9F1, 0xF1F1, 0xE000, 0x0000, 0xE0F1, 0xF1F1,
  // 0xF9F9, 0xF1F1, 0xF1E0, 0x0000, 0x0000, 0x00FF, 0x7F40, 0x4040,
  // 0x4040, 0x4040, 0x4040, 0x4040, 0x4141, 0x4141, 0x4141, 0x4141,
  // 0x4040, 0x4040, 0x4040, 0x4040, 0x4040, 0x4040, 0x4040, 0x4141,
  // 0x4143, 0x4343, 0x4343, 0x4141, 0x4140, 0x4040, 0x4040, 0x4040,
  // 0x4040, 0x4041, 0x4343, 0x4343, 0x4141, 0x4140, 0x4040, 0x4041,
  // 0x4343, 0x4343, 0x4141, 0x4140, 0x4040, 0x4040, 0x4143, 0x4300,
  // };



  const unsigned char go [] = {
  0xFF, 0x01, 0x01, 0x01, 0x01, 0x01, 0x01, 0x01, 0x01, 0x01, 0x01, 0x81, 0x81, 0xC1, 0xE1, 0xE1,
  0xE1, 0xF1, 0xF1, 0xF1, 0xF1, 0xF1, 0xF1, 0xF1, 0xF1, 0xF1, 0x71, 0x01, 0x01, 0x01, 0x01, 0x01,
  0x01, 0x01, 0x01, 0x81, 0xC1, 0xC1, 0xE1, 0xE1, 0xF1, 0xF1, 0xF1, 0xE1, 0xE1, 0xC1, 0xC1, 0x81,
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  0x43, 0x43, 0x43, 0x43, 0x41, 0x41, 0x41, 0x40, 0x40, 0x40, 0x40, 0x40, 0x41, 0x43, 0x43, 
  };


  sendCommand(Set_Column_Address_Cmd);
  sendCommand(0x00);
  sendCommand(0xFE);

  sendCommand(Set_Page_Address_Cmd);
  sendCommand(0x00);
  sendCommand(0x07);

  // We have to send the buffer as 16 bytes packets
  // Our buffer is 1024 bytes long, 1024/16 = 64
  // We have to send 64 packets
  for (uint8_t packet = 0; packet < 128; packet++) {
    Wire.beginTransmission(SlaveAddress);
    sendCommand(0x40);
    Wire.send(GOFi2cOLED_Data_Mode);
    for (uint8_t packet_byte = 0; packet_byte < 8; ++packet_byte) {
        Wire.send(go[packet*8+packet_byte]);
    }
    Wire.endTransmission();
  }


  // sendCommand(0b00100000);
  // sendData(0b11111111);
 //  sendData(0b11111111);
 //  sendData(0b11000011);
 //  sendData(0b11000011);
 //  sendData(0b11000011);
 //  sendData(0b11000011);
 //  sendData(0b11000011);
 //  sendData(0b11000011);
 //  sendData(0b11000011);
 //  sendData(0b11000011);
 //  sendData(0b11000011);
 //  sendData(0b11000011);
 //  sendData(0b11000011);
 //  sendData(0b11000011);
 //  sendData(0b11111111);
 //  sendData(0b11111111);
 //
 //
 //  sendData(0b11111111);
 //  sendData(0b11111111);
 //  sendData(0b11000011);
 //  sendData(0b11000011);
 //  sendData(0b11000011);
 //  sendData(0b11000011);
 //  sendData(0b11000011);
 //  sendData(0b11000011);
 //  sendData(0b11000011);
 //  sendData(0b11000011);
 //  sendData(0b11000011);
 //  sendData(0b11000011);
 //  sendData(0b11000011);
 //  sendData(0b11000011);
 //  sendData(0b11111111);
 //  sendData(0b11111111);


  // unsigned int data;
  // clipArea( col, row, w, h);
  // for( int i=0; i < w*h; i++) {
  //   data = getFlash( img, i);
  //   Wire.beginTransmission( SlaveAddress );
  //   Wire.send( GOFi2cOLED_Data_Mode) ;            // data mode
  //   Wire.send( data );
  //   Wire.endTransmission();
  // }
}


